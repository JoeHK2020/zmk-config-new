## boards/shields/KND/Kconfig.defconfig
```kconfig
if SHIELD_KND_L

config ZMK_KEYBOARD_NAME
    default "KBL"

config ZMK_SPLIT_ROLE_CENTRAL
    default y

config ZMK_SPLIT
    default y

config ZMK_BLE
    default y
endif

if SHIELD_KND_R

config ZMK_SPLIT
    default y

config ZMK_BLE
    default y
endif
```

## boards/shields/KND/Kconfig.shield
```kconfig
config SHIELD_KND_L
	def_bool $(shields_list_contains,KND_L)

config SHIELD_KND_R
	def_bool $(shields_list_contains,KND_R)
```

## boards/shields/Keiler/Kconfig.defconfig
```kconfig
if SHIELD_Kei_DONGLE

config ZMK_KEYBOARD_NAME
    default "Kei Dongle"

config ZMK_SPLIT_ROLE_CENTRAL
    default y

config ZMK_USB
    default y
endif

if SHIELD_KEI_LEFT || SHIELD_KEI_RIGHT || SHIELD_KEI_DONGLE

config ZMK_SPLIT
    default y

config ZMK_BLE
    default y
endif
```
